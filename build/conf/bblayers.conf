## build/conf/bblayers.conf
```bitbake
# POKY_BBLAYERS_CONF_VERSION is increased each time build/conf/bblayers.conf
# changes incompatibly
POKY_BBLAYERS_CONF_VERSION = "2"

BBPATH = "${TOPDIR}"
BBFILES ?= ""

BBLAYERS ?= " \
  ${TOPDIR}/../sources/poky/meta \
  ${TOPDIR}/../sources/poky/meta-poky \
  ${TOPDIR}/../sources/poky/../meta-openembedded/meta-oe \
  ${TOPDIR}/../sources/poky/../meta-openembedded/meta-python \
  ${TOPDIR}/../sources/poky/../meta-openembedded/meta-filesystems \
  ${TOPDIR}/../sources/poky/../meta-openembedded/meta-networking \
  ${TOPDIR}/../sources/poky/../meta-openembedded/meta-multimedia \
  ${TOPDIR}/../sources/poky/../meta-openembedded/meta-webserver \
  ${TOPDIR}/../sources/poky/../meta-virtualization \
  ${TOPDIR}/../sources/poky/../meta-security \
  ${TOPDIR}/../sources/poky/../meta-security/meta-tpm \
  ${TOPDIR}/../sources/poky/../meta-xilinx/meta-xilinx-core \
  ${TOPDIR}/../sources/poky/../meta-xilinx/meta-xilinx-standalone \
  ${TOPDIR}/../sources/poky/../meta-xilinx/meta-xilinx-standalone-sdt \
  ${TOPDIR}/../sources/poky/../meta-xilinx/meta-xilinx-multimedia \
  ${TOPDIR}/../sources/poky/../meta-xilinx/meta-xilinx-demos \
  ${TOPDIR}/../sources/poky/../meta-xilinx/meta-xilinx-virtualization \
  ${TOPDIR}/../sources/poky/../meta-xilinx/meta-xilinx-mali400 \
  ${TOPDIR}/../sources/poky/../meta-xilinx/meta-xilinx-gpu-malig78ae \
  ${TOPDIR}/../sources/poky/../meta-xilinx/meta-microblaze \
  ${TOPDIR}/../sources/poky/../meta-xilinx/meta-amd-zephyr \
  ${TOPDIR}/../sources/poky/../meta-xilinx-tsn \
  ${TOPDIR}/../sources/poky/../meta-openamp \
  ${TOPDIR}/../sources/poky/../meta-amd-edf \
  ${TOPDIR}/../sources/poky/../meta-amd-edf/meta-amd-edf-bsp \
  ${TOPDIR}/../sources/poky/../meta-kria \
  ${TOPDIR}/../sources/poky/../meta-amd-adaptive-socs/meta-amd-adaptive-socs-core \
  ${TOPDIR}/../sources/poky/../meta-amd-adaptive-socs/meta-amd-adaptive-socs-bsp \
  ${TOPDIR}/../sources/poky/../meta-xilinx/meta-xilinx-imgrcvry \
  ${TOPDIR}/../sources/poky/../meta-arm/meta-arm \
  ${TOPDIR}/../sources/poky/../meta-arm/meta-arm-toolchain \
  ${TOPDIR}/../sources/poky/../meta-jupyter \
  ${TOPDIR}/../sources/poky/../meta-ros/meta-ros-common \
  ${TOPDIR}/../sources/poky/../meta-ros/meta-ros2 \
  ${TOPDIR}/../sources/poky/../meta-ros/meta-ros2-jazzy \
  ${TOPDIR}/../sources/poky/../meta-qt5 \
  ${TOPDIR}/../sources/poky/../meta-vitis \
  ${TOPDIR}/../sources/poky/../meta-zephyr/meta-zephyr-core \
  ${TOPDIR}/../sources/poky/../meta-zephyr/meta-zephyr-bsp \
  ${TOPDIR}/../sources/poky/../meta-embedded-plus \
"
```
